/* Copyright (c) 2014, The Linux Foundation. All rights reserved.
 *
 * This program is free software; you can redistribute it and/or modify
 * it under the terms of the GNU General Public License version 2 and
 * only version 2 as published by the Free Software Foundation.
 *
 * This program is distributed in the hope that it will be useful,
 * but WITHOUT ANY WARRANTY; without even the implied warranty of
 * MERCHANTABILITY or FITNESS FOR A PARTICULAR PURPOSE.  See the
 * GNU General Public License for more details.
 */

/*---------------------------------------------------------------------------
 * This file is autogenerated file using gcdb parser. Please do not edit it.
 * Update input XML file to add a new entry or update variable in this file
 * VERSION = "1.0"
 *---------------------------------------------------------------------------*/
&mdss_mdp {
	dsi_otm1901a_tm_1080p_video: qcom,mdss_dsi_otm1901a_tm_1080p_video {
		qcom,mdss-dsi-panel-name = "otm1901a_1080p_video_TianMa";
		qcom,mdss-dsi-panel-controller = <&mdss_dsi0>;
		qcom,mdss-dsi-panel-type = "dsi_video_mode";
		qcom,mdss-dsi-panel-destination = "display_1";
		qcom,mdss-dsi-panel-framerate = <60>;
		qcom,mdss-dsi-virtual-channel-id = <0>;
		qcom,mdss-dsi-stream = <0>;
		qcom,mdss-dsi-panel-width = <1080>;
		qcom,mdss-dsi-panel-height = <1920>;
		qcom,mdss-dsi-h-front-porch = <60>;
		qcom,mdss-dsi-h-back-porch = <60>;
		qcom,mdss-dsi-h-pulse-width = <12>;
		qcom,mdss-dsi-h-sync-skew = <0>;
		qcom,mdss-dsi-v-back-porch = <30>;
		qcom,mdss-dsi-v-front-porch = <80>;
		qcom,mdss-dsi-v-pulse-width = <4>;
		qcom,mdss-dsi-h-left-border = <0>;
		qcom,mdss-dsi-h-right-border = <0>;
		qcom,mdss-dsi-v-top-border = <0>;
		qcom,mdss-dsi-v-bottom-border = <0>;
		qcom,mdss-dsi-bpp = <24>;
		qcom,mdss-dsi-color-order = "rgb_swap_rgb";
		qcom,mdss-dsi-underflow-color = <0xff>;
		qcom,mdss-dsi-border-color = <0>;
		qcom,mdss-dsi-on-command = [29 00 00 00 00 00 02 00 00
				29 01 00 00 00 00 04 FF 19 01 01
				29 01 00 00 00 00 02 00 80
				29 01 00 00 00 00 03 FF 19 01
				29 01 00 00 00 00 02 00 90
				29 01 00 00 00 00 02 B0 00
				29 01 00 00 00 00 02 00 00
				29 01 00 00 00 00 02 1C 33
				29 01 00 00 00 00 02 00 CD
				29 01 00 00 00 00 02 F5 19
				29 01 00 00 00 00 02 00 C1
				29 01 00 00 00 00 02 F5 15
				29 01 00 00 00 00 02 00 C3
				29 01 00 00 00 00 02 F5 15
				29 01 00 00 00 00 02 00 DB
				29 01 00 00 00 00 02 F5 19
				29 01 00 00 00 00 02 00 8D
				29 01 00 00 00 00 02 F5 20
				29 01 00 00 00 00 02 00 F5
				29 01 00 00 00 00 02 C1 40
				29 01 00 00 00 00 02 00 A2
				29 01 00 00 00 00 02 C1 30				
				29 01 00 00 00 00 02 00 B9
				29 01 00 00 00 00 02 C0 11
				29 01 00 00 00 00 02 00 A0
				29 01 00 00 00 00 07 CB FD FE FD FD FD FD
				29 01 00 00 00 00 02 00 E0
				29 01 00 00 00 00 07 CB 33 33 33 00 00 00
				29 01 00 00 00 00 02 00 F0
				29 01 00 00 00 00 07 CB 31 31 31 01 01 01
				29 01 00 00 00 00 02 00 82  
				29 01 00 00 00 00 02 D6 02  
				29 01 00 00 00 00 02 00 A0  
				29 01 00 00 00 00 0D D6 00 00 00 00 00 00 00 00 00 00 00 00  
				29 01 00 00 00 00 02 00 B0  
				29 01 00 00 00 00 0D D6 00 00 00 33 CD 33 33 33 80 33 33 33  
				29 01 00 00 00 00 02 00 C0  
				29 01 00 00 00 00 0D D6 44 00 00 22 89 22 22 22 55 22 22 22  
				29 01 00 00 00 00 02 00 D0  
				29 01 00 00 00 00 0D D6 44 00 00 11 44 11 11 11 2B 11 11 11
				29 01 00 00 00 00 02 81 80

				29 01 00 00 00 00 02 00 80
				29 01 00 00 00 00 0D D8 00 00 00 01 02 02 03 03 02 02 81 84
				29 01 00 00 00 00 02 00 90
				29 01 00 00 00 00 0D D8 00 01 01 02 02 02 03 04 05 06 0e 15
				29 01 00 00 00 00 02 00 A0
				29 01 00 00 00 00 0D D8 01 02 04 05 08 0b 0e 10 11 4c 66 7f
				29 01 00 00 00 00 02 00 B0
				29 01 00 00 00 00 0D D8 00 80 80 81 81 82 83 84 84 8e 93 97
				29 01 00 00 00 00 02 00 C0
				29 01 00 00 00 00 0D D8 81 82 82 83 85 87 89 8b 8e 95 9b a0
				29 01 00 00 00 00 02 00 D0
				29 01 00 00 00 00 0D D8 01 03 04 05 08 0a 0d 0f 12 25 34 42
				29 01 00 00 00 00 02 00 C0
				29 01 00 00 00 00 05 D7 82 80 C0 FF
				29 01 00 00 00 00 02 00 00

				//29 01 00 00 00 00 02 00 00
				//29 01 00 00 00 00 04 FF FF FF FF
				29 01 00 00 00 00 02 35 00
				29 01 00 00 00 00 02 51 FF
				29 01 00 00 00 00 02 53 2C	
				29 01 00 00 00 00 02 55 01	
				05 01 00 00 96 00 02 11 00
				05 01 00 00 32 00 02 29 00];
		qcom,mdss-dsi-off-command = [05 01 00 00 32 00 02 28 00
					05 01 00 00 78 00 02 10 00];
		qcom,mdss-dsi-on-command-state = "dsi_lp_mode";
		qcom,mdss-dsi-off-command-state = "dsi_hs_mode";
		qcom,mdss-dsi-h-sync-pulse = <1>;
		qcom,mdss-dsi-traffic-mode = "burst_mode";
		qcom,mdss-dsi-lane-map = "lane_map_0123";
		qcom,mdss-dsi-bllp-eof-power-mode;
		qcom,mdss-dsi-bllp-power-mode;
		qcom,esd-check-enabled; 
		qcom,mdss-dsi-panel-status-command-num = <1>;
		qcom,mdss-dsi-panel-status-command1 = [06 01 00 01 05 00 02 0A 08];
		qcom,mdss-dsi-panel-status-command-state = "dsi_hs_mode";
		qcom,mdss-dsi-panel-status-check-mode = "reg_read"; 
		qcom,mdss-dsi-panel-status-value1 = <1 0x9c>; 		
		qcom,mdss-dsi-lane-0-state;
		qcom,mdss-dsi-lane-1-state;
		qcom,mdss-dsi-lane-2-state;
		qcom,mdss-dsi-lane-3-state;
		qcom,mdss-dsi-panel-timings = [E6 38 26 00 68 6C 2A 3A 2C 03 04 00];
		qcom,mdss-dsi-t-clk-post = <0x02>;
		qcom,mdss-dsi-t-clk-pre = <0x2B>;
		qcom,mdss-dsi-bl-min-level = <3>;
		qcom,mdss-dsi-bl-max-level = <255>;
		qcom,mdss-dsi-bl-pmic-pwm-frequency = <40>;
		qcom,mdss-dsi-bl-pmic-bank-select = <0>;
		qcom,mdss-dsi-dma-trigger = "trigger_sw";
		qcom,mdss-dsi-mdp-trigger = "none";
		qcom,mdss-dsi-bl-pmic-control-type = "bl_ctrl_pwm";
		qcom,mdss-dsi-reset-sequence = <1 20>, <0 2>, <1 20>;
		qcom,mdss-pan-physical-width-dimension = <64>;
		qcom,mdss-pan-physical-height-dimension = <117>;
		qcom,mdss-dsi-panel-gamma-command-state = "dsi_hs_mode";
		qcom,mdss-dsi-panel-hue-command-num = <22>;
		qcom,mdss-dsi-panel-saturation-command-num = <4>;

	qcom,mdss-dsi-panel-hue-command01 = [ 
	//5000
	29 01 00 00 00 00 02 00 00
	29 01 00 00 00 00 02 84 ff
	];
	
	
	qcom,mdss-dsi-panel-hue-command02 = [ 
	//5300
	29 01 00 00 00 00 02 00 00
	29 01 00 00 00 00 02 84 f8	
	];
	
	
	qcom,mdss-dsi-panel-hue-command03 = [ 
	//5500
	29 01 00 00 00 00 02 00 00
	29 01 00 00 00 00 02 84 f2
	];
	
	
	qcom,mdss-dsi-panel-hue-command04 = [ 
	//5770
	29 01 00 00 00 00 02 00 00
	29 01 00 00 00 00 02 84 ec
	];
	
	qcom,mdss-dsi-panel-hue-command05 = [
	//6000
	29 01 00 00 00 00 02 00 00
	29 01 00 00 00 00 02 84 e5
	];
	
	
	qcom,mdss-dsi-panel-hue-command06 = [
	
	//6220 
	29 01 00 00 00 00 02 00 00
	29 01 00 00 00 00 02 84 dd
	];
	
	qcom,mdss-dsi-panel-hue-command07 = [
	
	//6530	 
	29 01 00 00 00 00 02 00 00
	29 01 00 00 00 00 02 84 d7
	];
		
	qcom,mdss-dsi-panel-hue-command08 = [
	
	//6760 
	29 01 00 00 00 00 02 00 00
	29 01 00 00 00 00 02 84 d2
	];
	
	qcom,mdss-dsi-panel-hue-command09 = [
	//7000
	29 01 00 00 00 00 02 00 00
	29 01 00 00 00 00 02 84 cc
	];                    
		
	qcom,mdss-dsi-panel-hue-command10 = [
	//7250
	29 01 00 00 00 00 02 00 00
	29 01 00 00 00 00 02 84 c6
	];
	
	qcom,mdss-dsi-panel-hue-command11 = [
	//7530
	29 01 00 00 00 00 02 00 00
	29 01 00 00 00 00 02 84 c3
	];
	
	qcom,mdss-dsi-panel-hue-command12 = [
	//7750
	29 01 00 00 00 00 02 00 00
	29 01 00 00 00 00 02 84 81
	];
	
	qcom,mdss-dsi-panel-hue-command13 = [  
	//8050
	29 01 00 00 00 00 02 00 00
	29 01 00 00 00 00 02 84 82
	];
		
	qcom,mdss-dsi-panel-hue-command14 = [ 
	//8300 
	29 01 00 00 00 00 02 00 00
	29 01 00 00 00 00 02 84 94
	];
		
	qcom,mdss-dsi-panel-hue-command15 = [ 
	//8530 
	29 01 00 00 00 00 02 00 00
	29 01 00 00 00 00 02 84 a3
	];
	
	qcom,mdss-dsi-panel-hue-command16 = [ 
	//8780 
	29 01 00 00 00 00 02 00 00
	29 01 00 00 00 00 02 84 a6
	];
	
	
	qcom,mdss-dsi-panel-hue-command17 = [  
	//9020
	29 01 00 00 00 00 02 00 00
	29 01 00 00 00 00 02 84 aa

	];
	
	qcom,mdss-dsi-panel-hue-command18 = [ 
	
	//9260 
	29 01 00 00 00 00 02 00 00
	29 01 00 00 00 00 02 84 ad
	];
	
	qcom,mdss-dsi-panel-hue-command19 = [  
	//9500
	29 01 00 00 00 00 02 00 00
	29 01 00 00 00 00 02 84 b0
	];
	
	qcom,mdss-dsi-panel-hue-command20= [  
	//9770
	29 01 00 00 00 00 02 00 00
	29 01 00 00 00 00 02 84 b5
	];
	
	qcom,mdss-dsi-panel-hue-command21 = [  
	//10000
	29 01 00 00 00 00 02 00 00
	29 01 00 00 00 00 02 84 b7
	];

	qcom,mdss-dsi-panel-hue-command22 = [ 
	//default gamma
	29 01 00 00 00 00 02 00 00
	29 01 00 00 00 00 02 84 c6
	];	
	
	qcom,mdss-dsi-panel-saturation-command01 = [

	29 01 00 00 00 00 02 81 00 //CE\C7л\BB 00/80/81/83 ==> OFF/Low/Mid/High 
	29 00 00 00 00 00 02 00 00	
	29 01 00 00 00 00 02 FB 01		
	];
	qcom,mdss-dsi-panel-saturation-command02 = [

	29 01 00 00 00 00 02 81 80 //CE\C7л\BB 00/80/81/83 ==> OFF/Low/Mid/High 
	29 00 00 00 00 00 02 00 00	
	29 01 00 00 00 00 02 FB 01		
	];
	qcom,mdss-dsi-panel-saturation-command03 = [

	29 01 00 00 00 00 02 81 81 //CE\C7л\BB 00/80/81/83 ==> OFF/Low/Mid/High 
	29 00 00 00 00 00 02 00 00	
	29 01 00 00 00 00 02 FB 01		
	];
	qcom,mdss-dsi-panel-saturation-command04 = [

	29 01 00 00 00 00 02 81 83 //CE\C7л\BB 00/80/81/83 ==> OFF/Low/Mid/High 
	29 00 00 00 00 00 02 00 00	
	29 01 00 00 00 00 02 FB 01		
	];	
		
	};
};
