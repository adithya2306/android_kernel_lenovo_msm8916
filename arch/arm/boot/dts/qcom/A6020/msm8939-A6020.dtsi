#include "../msm8939-qrd.dtsi"
#include "msm8939-pinctrl-A6020.dtsi"
#include "msm8939-qrd-A6020.dtsi"
#include "msm8939-pm-A6020.dtsi"
#include "msm8939-memory-A6020.dtsi"
#include "msm-pm8916-A6020.dtsi"
#include "msm8939-regulator-A6020.dtsi"
#include "msm8939-camera-sensor-qrd-A6020.dtsi"
#include "msm8939-qrd-skuh-A6020.dtsi"
