/* Copyright (c) 2014, The Linux Foundation. All rights reserved.
 *
 * This program is free software; you can redistribute it and/or modify
 * it under the terms of the GNU General Public License version 2 and
 * only version 2 as published by the Free Software Foundation.
 *
 * This program is distributed in the hope that it will be useful,
 * but WITHOUT ANY WARRANTY; without even the implied warranty of
 * MERCHANTABILITY or FITNESS FOR A PARTICULAR PURPOSE.  See the
 * GNU General Public License for more details.
 */

/*---------------------------------------------------------------------------
 * This file is autogenerated file using gcdb parser. Please do not edit it.
 * Update input XML file to add a new entry or update variable in this file
 * VERSION = "1.0"
 *---------------------------------------------------------------------------*/
&mdss_mdp {
	dsi_hx8394f_boe_720p_video: qcom,mdss_dsi_hx8394f_720p_video {
		qcom,mdss-dsi-panel-name = "hx8394F_HD720p_video_BOE";
		qcom,mdss-dsi-panel-controller = <&mdss_dsi0>;
		qcom,mdss-dsi-panel-type = "dsi_video_mode";
		qcom,mdss-dsi-panel-destination = "display_1";
		qcom,mdss-dsi-panel-framerate = <60>;
		qcom,mdss-dsi-virtual-channel-id = <0>;
		qcom,mdss-dsi-stream = <0>;
		qcom,mdss-dsi-panel-width = <720>;
		qcom,mdss-dsi-panel-height = <1280>;
		qcom,mdss-dsi-h-front-porch = <64>;
		qcom,mdss-dsi-h-back-porch = <54>;
		qcom,mdss-dsi-h-pulse-width = <30>;
		qcom,mdss-dsi-h-sync-skew = <0>;
		qcom,mdss-dsi-v-back-porch = <12>;
		qcom,mdss-dsi-v-front-porch = <8>;
		qcom,mdss-dsi-v-pulse-width = <2>;
		qcom,mdss-dsi-h-left-border = <0>;
		qcom,mdss-dsi-h-right-border = <0>;
		qcom,mdss-dsi-v-top-border = <0>;
		qcom,mdss-dsi-v-bottom-border = <0>;
		qcom,mdss-dsi-bpp = <24>;
		qcom,mdss-dsi-color-order = "rgb_swap_rgb";
		qcom,mdss-dsi-underflow-color = <0xff>;
		qcom,mdss-dsi-border-color = <0>;
		qcom,mdss-dsi-on-command = [39 01 00 00 00 00 04 B9 FF 83 94 						
			05 01 00 00 78 00 02 11 00	
			05 01 00 00 14 00 02 29 00];
			
		qcom,mdss-dsi-off-command = [05 01 00 00 32 00 02 28 00
			05 01 00 00 78 00 02 10 00];
		qcom,mdss-dsi-on-command-state = "dsi_lp_mode";
		qcom,mdss-dsi-off-command-state = "dsi_hs_mode";
		qcom,mdss-dsi-h-sync-pulse = <1>;
		qcom,mdss-dsi-traffic-mode = "burst_mode";
		qcom,mdss-dsi-lane-map = "lane_map_0123";
		qcom,mdss-dsi-bllp-eof-power-mode;
		qcom,mdss-dsi-bllp-power-mode;
		qcom,mdss-dsi-lane-0-state;
		qcom,mdss-dsi-lane-1-state;
		qcom,mdss-dsi-lane-2-state;
		qcom,mdss-dsi-lane-3-state;
		qcom,mdss-dsi-panel-timings = [7B 1A 10 00 3C 40 14 1C 15 03 04 00];
		qcom,mdss-dsi-t-clk-post = <0x04>;
		qcom,mdss-dsi-t-clk-pre = <0x1A>;
		qcom,mdss-dsi-bl-min-level = <3>;
		qcom,mdss-dsi-bl-max-level = <255>;
		qcom,mdss-dsi-bl-pmic-pwm-frequency = <100>;
		qcom,mdss-dsi-bl-pmic-bank-select = <0>;
		qcom,mdss-dsi-dma-trigger = "trigger_sw";
		qcom,mdss-dsi-mdp-trigger = "none";
		qcom,mdss-dsi-bl-pmic-control-type = "bl_ctrl_pwm";
		qcom,mdss-dsi-reset-sequence = <1 50>, <0 20>, <1 5>;
		qcom,mdss-pan-physical-width-dimension = <65>;
		qcom,mdss-pan-physical-height-dimension = <118>;
		qcom,mdss-dsi-panel-gamma-command-state = "dsi_hs_mode";
		qcom,mdss-dsi-panel-hue-command-num = <22>;
		qcom,mdss-dsi-panel-saturation-command-num = <4>;


		qcom,mdss-dsi-panel-hue-command01 = [
39 01 00 00 00 00 02 BD 00 
39 01 00 00 00 00 2C C1 01 00 08 10 19 21 2A 31 39 40 47 4D 55 5C 63 6B 73 7B 83 8A 92 9A A2 AA B3 BA C2 CA D3 DC E5 ED F6 FF 2C 9F 88 54 88 5E 9F 5B C0
39 01 00 00 00 00 02 BD 01
39 01 00 00 00 00 2B C1 00 06 0C 13 19 21 28 2F 35 3B 41 46 4B 51 57 5D 63 69 70 76 7D 83 89 90 96 9D A3 AA B1 B7 BE C4 CB 2C 44 61 A9 77 BC 8F F2 C0   
39 01 00 00 00 00 02 BD 02
39 01 00 00 00 00 2B C1 00 05 0B 11 16 1D 25 2B 31 37 3C 42 46 4B 51 56 5B 61 66 6C 72 78 7E 84 89 8F 94 9B A0 A6 AD B3 B8 34 F3 AC D1 CE A8 8C B6 C0   
];                   
		qcom,mdss-dsi-panel-hue-command02 = [
39 01 00 00 00 00 02 BD 00 
39 01 00 00 00 00 2C C1 01 00 08 10 19 21 2A 31 39 40 47 4D 54 5C 63 6A 73 7B 83 8A 91 9A A2 AA B3 BA C2 CA D3 DC E5 ED F6 FF 2C 8E 8B 1D 0A 55 9B DB C0
39 01 00 00 00 00 02 BD 01 
39 01 00 00 00 00 2B C1 00 06 0C 13 19 21 28 2F 35 3B 41 46 4C 52 58 5E 64 6A 71 77 7E 84 8A 91 98 9E A5 AC B3 B9 BF C6 CE 2C 59 FB 11 3B FD 3A EE 00   
39 01 00 00 00 00 02 BD 02
39 01 00 00 00 00 2B C1 00 06 0B 11 17 1E 26 2C 32 38 3E 43 48 4D 52 58 5D 63 69 6E 75 7B 81 86 8C 92 98 9E A4 AB B1 B7 BC 0F B2 A0 09 87 53 9A CD C0   
 ];                  
		qcom,mdss-dsi-panel-hue-command03 = [
39 01 00 00 00 00 02 BD 00
39 01 00 00 00 00 2C C1 01 00 08 10 19 21 2A 31 39 40 46 4D 54 5C 63 6A 73 7A 82 8A 91 99 A2 AA B3 BA C2 CA D3 DC E5 ED F6 FF 2C 8E B6 0D F7 D4 46 4A C0
39 01 00 00 00 00 02 BD 01
39 01 00 00 00 00 2B C1 00 06 0C 13 19 21 29 2F 36 3C 42 47 4C 53 59 5F 65 6C 72 79 80 86 8C 92 99 A0 A7 AE B5 BB C1 C8 D0 2C B3 21 C1 0D 16 96 5F 40   
39 01 00 00 00 00 02 BD 02
39 01 00 00 00 00 2B C1 00 06 0C 12 18 1F 27 2D 33 39 3F 44 49 4E 54 5A 5F 65 6B 71 78 7E 84 89 8F 95 9C A2 A8 AF B5 BB C1 00 33 B5 75 AF 23 F2 EC 00   
 ];                  
		qcom,mdss-dsi-panel-hue-command04 = [
39 01 00 00 00 00 02 BD 00
39 01 00 00 00 00 2C C1 01 00 08 10 19 21 2A 31 39 40 46 4D 55 5C 63 6B 73 7B 83 8A 91 9A A2 AA B3 BA C2 CA D4 DC E5 ED F6 FF 2C 4E 74 54 47 1A 98 8F C0
39 01 00 00 00 00 02 BD 01
39 01 00 00 00 00 2B C1 00 06 0D 13 1A 22 29 30 36 3D 42 48 4D 54 5A 60 66 6D 73 7A 81 87 8D 94 9B A2 A9 B0 B7 BD C3 CB D2 22 09 C8 C0 5E 6D 46 0C C0   
39 01 00 00 00 00 02 BD 02 
39 01 00 00 00 00 2B C1 00 06 0C 12 18 20 28 2E 34 3B 40 45 4A 50 56 5C 61 68 6E 74 7B 81 87 8D 93 99 A0 A6 AD B3 B9 BF C5 16 F3 CB F8 C6 10 22 79 80   
 ];                  
		qcom,mdss-dsi-panel-hue-command05 = [
39 01 00 00 00 00 02 BD 00
39 01 00 00 00 00 2C C1 01 00 08 10 18 21 29 31 39 40 46 4D 55 5B 63 6B 73 7B 83 8A 92 9A A2 AA B3 BA C2 CA D3 DC E5 ED F6 FF 1B 39 B4 D0 44 09 5F 5A C0
39 01 00 00 00 00 02 BD 01 
39 01 00 00 00 00 2B C1 00 06 0D 13 1A 22 2A 30 37 3D 43 48 4E 54 5A 60 67 6E 75 7B 82 88 8F 95 9C A3 AA B2 B8 BE C5 CC D5 27 63 52 7F 43 63 ED BB 00   
39 01 00 00 00 00 02 BD 02
39 01 00 00 00 00 2B C1 00 06 0C 13 19 21 29 2F 36 3C 41 47 4C 52 58 5D 63 6A 70 77 7D 83 89 90 96 9D A3 AA B1 B7 BD C3 C9 2D A3 08 13 DD FC 49 50 C0   
 ];                  
		qcom,mdss-dsi-panel-hue-command06 = [
39 01 00 00 00 00 02 BD 00
39 01 00 00 00 00 2C C1 01 00 08 10 19 21 29 31 39 40 46 4D 54 5B 63 6B 73 7B 82 8A 92 99 A1 AA B3 BA C2 CA D3 DC E5 ED F6 FF 2C 79 7B C4 34 7D 9F 9B C0
39 01 00 00 00 00 02 BD 01
39 01 00 00 00 00 2B C1 00 06 0D 13 1A 22 2A 31 37 3D 43 49 4F 55 5B 61 68 6F 76 7D 83 89 90 97 9E A5 AC B3 B9 C0 C7 CE D7 27 74 B8 1A 40 24 07 D7 40   
39 01 00 00 00 00 02 BD 02
39 01 00 00 00 00 2B C1 00 06 0D 13 1A 22 29 30 36 3D 42 48 4D 53 59 5F 65 6C 73 79 7F 86 8C 92 99 A0 A7 AE B4 BA C0 C7 CE 22 1E CC BE D3 CB 90 ED 80   
 ];                  
		qcom,mdss-dsi-panel-hue-command07 = [
39 01 00 00 00 00 02 BD 00 
39 01 00 00 00 00 2C C1 01 00 08 10 19 21 29 31 39 40 46 4D 54 5B 62 6A 73 7A 82 8A 91 99 A2 AA B3 BA C1 CA D3 DC E5 ED F6 FF 2C 79 B6 FC F2 C9 76 5A C0
39 01 00 00 00 00 02 BD 01
39 01 00 00 00 00 2B C1 00 06 0D 14 1A 23 2A 31 38 3E 44 49 4F 55 5B 62 68 70 76 7D 84 8A 91 98 9F A6 AD B5 BB C1 C9 D0 D9 24 89 11 BD CF 75 5C 73 00   
39 01 00 00 00 00 02 BD 02 
39 01 00 00 00 00 2B C1 00 06 0D 14 1A 23 2A 31 38 3E 43 49 4F 55 5B 61 67 6E 75 7B 82 88 8F 95 9C A3 AA B1 B7 BD C4 CB D2 34 89 0C 01 A3 72 82 F5 C0   
 ];
		qcom,mdss-dsi-panel-hue-command08 = [
39 01 00 00 00 00 02 BD 00 
39 01 00 00 00 00 2C C1 01 00 08 10 18 20 29 31 38 3F 46 4C 53 5B 62 6A 72 79 82 89 91 99 A1 A9 B2 BA C1 CA D3 DC E5 ED F6 FF 16 E7 CB 05 CD 6F 30 06 C0
39 01 00 00 00 00 02 BD 01
39 01 00 00 00 00 2B C1 00 06 0D 14 1A 23 2A 31 38 3E 44 49 4F 55 5C 62 69 70 77 7E 85 8B 92 99 A0 A7 AF B6 BC C3 CA D2 DA 24 D9 11 B6 16 25 64 5E C0   
39 01 00 00 00 00 02 BD 02
39 01 00 00 00 00 2B C1 00 06 0D 14 1A 23 2A 31 38 3E 44 49 4F 55 5C 62 68 6F 76 7D 84 8A 91 97 9E A5 AD B4 BA C0 C7 CF D7 34 EE 51 60 6A 23 F5 7C 00   
 ];
		qcom,mdss-dsi-panel-hue-command09 = [
39 01 00 00 00 00 02 BD 00
39 01 00 00 00 00 2C C1 01 00 08 10 18 21 29 31 39 40 46 4D 54 5B 62 6A 73 7A 82 8A 91 99 A1 AA B3 BA C2 CA D3 DC E5 ED F6 FF 1B 39 77 FC 63 F4 4A 4A C0
39 01 00 00 00 00 02 BD 01 
39 01 00 00 00 00 2B C1 00 07 0D 14 1B 23 2B 32 38 3F 44 4A 50 57 5D 63 6A 71 78 7F 86 8C 93 9A A1 A9 B0 B7 BD C4 CC D4 DC 0E 78 DD CB 6F 3A 89 F5 40   
39 01 00 00 00 00 02 BD 02
39 01 00 00 00 00 2B C1 00 07 0D 14 1B 24 2C 32 39 40 45 4B 51 57 5E 64 6A 72 79 80 86 8D 93 9A A1 A9 B0 B7 BD C4 CB D2 DA 0F E7 88 B2 C5 8F C8 47 80   
 ];
		qcom,mdss-dsi-panel-hue-command10 = [
39 01 00 00 00 00 02 BD 00
39 01 00 00 00 00 2C C1 01 00 08 10 18 21 29 31 39 40 46 4D 54 5C 63 6B 73 7B 82 8A 91 99 A2 AA B3 BA C1 CA D3 DC E5 ED F6 FF 1B 3D 77 00 37 C5 75 56 C0
39 01 00 00 00 00 02 BD 01
39 01 00 00 00 00 2B C1 00 07 0D 14 1B 24 2B 32 39 3F 45 4A 51 57 5E 64 6B 72 79 80 87 8D 94 9B A3 AA B2 B8 BF C6 CD D6 DE 0E 8E 67 B2 AE 7F 17 1D 00   
39 01 00 00 00 00 02 BD 02 
39 01 00 00 00 00 2B C1 00 07 0E 15 1C 25 2D 33 3A 40 46 4C 53 59 5F 66 6D 74 7B 82 88 8F 96 9D A4 AC B3 BA C0 C7 CE D7 DE 16 93 B9 19 59 EA CC 6C 40   
 ];
		qcom,mdss-dsi-panel-hue-command11 = [
39 01 00 00 00 00 02 BD 00
39 01 00 00 00 00 2C C1 01 00 08 10 18 21 29 31 39 40 46 4D 54 5C 63 6B 72 7B 82 8A 91 99 A1 AA B3 BA C2 CA D3 DC E5 ED F6 FF 1B 39 77 03 26 F5 45 46 C0
39 01 00 00 00 00 02 BD 01
39 01 00 00 00 00 2B C1 00 07 0D 14 1B 24 2C 32 39 3F 45 4B 51 58 5E 65 6C 73 7A 81 87 8E 95 9C A3 AB B3 B9 C0 C7 CF D7 DF 0E 93 B8 D8 05 E6 D1 12 00   
39 01 00 00 00 00 02 BD 02
39 01 00 00 00 00 2B C1 00 07 0E 15 1D 25 2D 34 3B 41 47 4D 54 5A 60 67 6E 75 7D 83 8A 91 98 9F A7 AE B5 BC C3 CA D2 DA E1 1B 3A 65 2E F7 9B 3C 14 80   
 ];
		qcom,mdss-dsi-panel-hue-command12 = [
39 01 00 00 00 00 02 BD 00
39 01 00 00 00 00 2C C1 01 00 08 10 18 20 29 31 39 40 46 4D 54 5B 63 6B 72 7B 82 8A 91 99 A2 AA B3 BA C2 CA D3 DC E5 ED F6 FF 16 E9 A3 82 37 C4 49 9F C0
39 01 00 00 00 00 02 BD 01
39 01 00 00 00 00 2B C1 00 07 0E 15 1C 24 2C 33 3A 40 46 4B 52 59 5F 65 6D 74 7B 82 89 8F 96 9E A5 AD B4 BB C1 C9 D1 D9 E1 00 24 13 47 59 3D 48 D6 80   
39 01 00 00 00 00 02 BD 02
39 01 00 00 00 00 2B C1 00 07 0E 16 1D 26 2E 35 3C 42 48 4E 55 5C 62 69 71 78 7F 86 8D 94 9B A3 AA B2 B9 BF C7 CF D7 DE E6 2D EA A7 5A 5E 6D F7 4B 40   
 ];
		qcom,mdss-dsi-panel-hue-command13 = [
39 01 00 00 00 00 02 BD 00
39 01 00 00 00 00 2C C1 01 00 08 10 18 20 29 31 39 40 46 4D 54 5B 63 6A 72 7A 82 89 91 99 A1 AA B2 BA C1 CA D3 DC E4 ED F6 FF 16 E8 27 8F DE A3 30 35 C0
39 01 00 00 00 00 02 BD 01
39 01 00 00 00 00 2B C1 00 07 0E 15 1C 24 2C 33 3A 40 46 4C 52 59 60 66 6E 75 7C 83 8A 90 97 9F A6 AE B5 BC C3 CA D2 DA E3 00 39 69 E3 05 2C 99 2F 00   
39 01 00 00 00 00 02 BD 02
39 01 00 00 00 00 2B C1 00 07 0F 17 1E 27 2F 36 3D 43 49 50 56 5D 64 6B 73 7A 81 89 8F 97 9E A6 AE B5 BC C3 CA D3 DB E2 EA 34 95 69 FB 6C C8 25 C3 40   
 ];
		qcom,mdss-dsi-panel-hue-command14 = [
39 01 00 00 00 00 02 BD 00 
39 01 00 00 00 00 2C C1 01 00 08 10 18 20 29 31 39 40 46 4D 54 5B 62 6A 72 7A 82 8A 91 99 A1 A9 B3 BA C1 CA D3 DC E5 ED F6 FF 15 A5 20 FF 52 AC 71 8A C0
39 01 00 00 00 00 02 BD 01
39 01 00 00 00 00 2B C1 00 07 0E 15 1C 25 2D 33 3A 41 47 4C 53 5A 60 67 6E 76 7D 84 8B 92 99 A0 A8 B0 B7 BD C5 CC D5 DD E5 06 93 C3 DF C9 07 57 34 40   
39 01 00 00 00 00 02 BD 02
39 01 00 00 00 00 2B C1 00 08 0F 17 1F 28 30 37 3E 44 4A 51 58 5F 66 6E 75 7D 84 8B 92 9A A1 A9 B2 B8 BF C7 CF D7 DF E7 EE 0E 52 69 98 05 8B 3C 78 80   
 ];
		qcom,mdss-dsi-panel-hue-command15 = [
39 01 00 00 00 00 02 BD 00
39 01 00 00 00 00 2C C1 01 00 08 10 18 20 29 31 39 40 46 4C 54 5B 62 6A 72 7A 82 89 91 99 A1 A9 B2 BA C1 C9 D3 DB E4 ED F6 FF 15 A4 2E 6A 5D 5E 2C F5 C0
39 01 00 00 00 00 02 BD 01
39 01 00 00 00 00 2B C1 00 07 0E 15 1C 25 2D 34 3B 41 47 4D 54 5A 61 68 6F 76 7E 85 8B 92 9A A1 A9 B1 B8 BE C6 CE D6 DE E6 06 E5 25 25 B4 F6 53 0E 80   
39 01 00 00 00 00 02 BD 02
39 01 00 00 00 00 2B C1 00 08 10 18 20 29 30 38 3F 45 4B 52 59 60 68 6F 77 7F 86 8D 94 9C A4 AC B4 BB C2 CA D2 DB E3 EA F2 00 0D 27 A2 05 D5 99 C7 40   
 ];
		qcom,mdss-dsi-panel-hue-command16 = [
39 01 00 00 00 00 02 BD 00 
39 01 00 00 00 00 2C C1 01 00 08 10 18 20 29 31 39 40 46 4C 54 5B 62 6A 72 7A 82 89 91 99 A1 A9 B3 BA C1 C9 D3 DB E4 ED F6 FF 15 54 1D A9 DD 5C 2C F2 C0
39 01 00 00 00 00 02 BD 01 
39 01 00 00 00 00 2B C1 00 07 0E 15 1D 25 2D 34 3B 41 47 4D 54 5B 61 69 70 77 7F 86 8C 94 9B A2 AA B2 B9 C0 C7 CF D8 E0 E8 1B 3A BB DC 74 CB B4 A4 00   
39 01 00 00 00 00 02 BD 02
39 01 00 00 00 00 2B C1 00 08 10 18 20 29 31 39 40 46 4C 53 5B 61 69 71 79 81 88 8F 97 9F A7 AF B7 BE C5 CD D6 DE E6 EE F6 16 A4 1B 39 46 02 0B E8 40   
 ];
		qcom,mdss-dsi-panel-hue-command17 = [
39 01 00 00 00 00 02 BD 00 
39 01 00 00 00 00 2C C1 01 00 08 10 18 20 29 31 39 40 46 4D 54 5B 62 6A 72 7A 82 89 91 99 A1 A9 B2 B9 C1 C9 D2 DC E4 ED F6 FF 15 94 11 66 80 1F 8B 32 C0
39 01 00 00 00 00 02 BD 01
39 01 00 00 00 00 2B C1 00 07 0E 16 1D 25 2D 34 3B 42 48 4E 55 5B 62 69 71 78 7F 86 8D 94 9C A3 AB B3 BA C1 C8 D1 D9 E1 E9 2C 7F C1 36 2A B7 B0 CA 80   
39 01 00 00 00 00 02 BD 02
39 01 00 00 00 00 2B C1 00 08 10 19 21 2A 32 39 40 47 4D 55 5C 63 6B 73 7B 82 89 91 99 A1 A9 B2 B9 C0 C8 D1 D9 E2 E9 F1 F9 2C 43 CC 10 29 59 24 CF 80   
 ];
		qcom,mdss-dsi-panel-hue-command18 = [
39 01 00 00 00 00 02 BD 00 
39 01 00 00 00 00 2C C1 01 00 08 10 18 20 29 31 38 3F 46 4C 54 5B 62 6A 72 7A 81 89 91 98 A1 A9 B2 B9 C1 C9 D2 DB E4 EC F6 FF 00 07 D9 00 74 C9 85 9C C0
39 01 00 00 00 00 02 BD 01
39 01 00 00 00 00 2B C1 00 07 0E 16 1D 26 2D 34 3B 42 48 4E 55 5B 62 6A 71 78 80 87 8E 95 9C A4 AC B4 BA C1 C9 D1 DA E2 EA 2C 4F D2 78 B5 5D 5F B2 40   
39 01 00 00 00 00 02 BD 02
39 01 00 00 00 00 2B C1 00 08 10 19 21 2A 32 3A 41 47 4E 56 5D 64 6C 74 7C 84 8B 93 9B A3 AB B4 BB C2 CB D3 DC E4 EC F4 FC 2D A9 74 05 89 5D 73 67 C0   
	];
		qcom,mdss-dsi-panel-hue-command19 = [
39 01 00 00 00 00 02 BD 00
39 01 00 00 00 00 2C C1 01 00 08 10 18 20 29 31 38 3F 46 4C 54 5B 62 6A 72 7A 81 89 90 98 A1 A9 B2 B9 C1 C9 D2 DB E4 ED F6 FF 00 03 C8 14 33 C4 45 91 C0
39 01 00 00 00 00 02 BD 01  
39 01 00 00 00 00 2B C1 00 07 0E 16 1D 26 2E 35 3C 42 48 4F 55 5C 63 6A 72 79 80 87 8E 96 9D A5 AD B5 BB C3 CA D3 DB E3 EB 2C 91 68 E2 2F CD 4C DB C0   
39 01 00 00 00 00 02 BD 02
39 01 00 00 00 00 2B C1 00 08 11 19 22 2B 33 3B 42 48 4F 57 5E 65 6D 75 7E 85 8D 95 9D A5 AE B6 BD C5 CD D7 DF E7 EF F7 FF 22 10 18 3F 70 64 5C 66 C0   
 ];
		qcom,mdss-dsi-panel-hue-command20 = [
39 01 00 00 00 00 02 BD 00
39 01 00 00 00 00 2C C1 01 00 08 0F 17 1F 28 30 37 3F 45 4B 53 5A 61 68 70 78 80 87 8F 96 9F A7 AF B7 BE C6 CF D8 E1 EA F3 FD 0F EB 29 5D 9C 82 A9 91 00
39 01 00 00 00 00 02 BD 01 
39 01 00 00 00 00 2B C1 00 07 0E 16 1D 26 2D 34 3B 42 48 4E 55 5C 62 69 71 78 80 86 8D 95 9C A4 AC B4 BA C1 C9 D1 D9 E1 E9 2C 4F D2 4A 63 C8 0A 6F C0   
39 01 00 00 00 00 02 BD 02
39 01 00 00 00 00 2B C1 00 08 11 19 22 2B 33 3A 42 48 4F 57 5E 65 6D 75 7E 85 8D 95 9D A5 AE B6 BD C5 CD D7 DF E7 EF F7 FF 37 53 28 7E 24 20 9C 56 C0   
 ];
		qcom,mdss-dsi-panel-hue-command21 = [
39 01 00 00 00 00 02 BD 00
39 01 00 00 00 00 2C C1 01 00 08 0F 17 1F 28 2F 37 3E 45 4B 51 59 60 67 6F 77 7F 86 8D 95 9D A5 AD B5 BC C4 CC D6 DE E7 EF F9 0E 4E 83 4D 02 01 76 23 80
39 01 00 00 00 00 02 BD 01
39 01 00 00 00 00 2B C1 00 07 0E 15 1D 25 2D 34 3B 41 47 4D 54 5B 62 69 70 77 7F 86 8D 94 9B A2 AA B2 B9 C0 C7 CF D8 E0 E8 1B 3A BF D1 B4 0B F4 B5 00   
39 01 00 00 00 00 02 BD 02
39 01 00 00 00 00 2B C1 00 08 11 19 22 2B 33 3B 42 48 4F 56 5E 65 6E 76 7E 85 8D 95 9D A5 AE B6 BD C5 CD D7 DF E7 EF F7 FF 37 50 2F 70 65 A0 9C 66 C0   
 ];
		qcom,mdss-dsi-panel-hue-command22 = [
39 01 00 00 00 00 02 BD 00
39 01 00 00 00 00 2C C1 01 00 08 10 18 20 29 31 39 40 46 4D 54 5B 62 6A 72 7A 82 8A 91 99 A2 AA B3 BA C2 CA D3 DC E5 ED F6 FF 16 E8 23 FF E6 C9 8E 8A C0
39 01 00 00 00 00 02 BD 01
39 01 00 00 00 00 2B C1 00 07 0E 16 1D 26 2E 35 3C 42 48 4F 56 5C 63 6A 72 79 81 88 8F 96 9E A5 AD B5 BC C3 CB D4 DC E4 EC 2C 95 79 27 74 67 E6 86 80   
39 01 00 00 00 00 02 BD 02 
39 01 00 00 00 00 2B C1 00 07 0E 16 1D 26 2E 35 3C 42 48 4E 55 5B 62 69 71 78 7F 86 8D 94 9B A3 AA B2 B9 BF C7 CE D7 DE E6 2D A9 67 BB 1D 5C F7 36 00   
 ];
 	qcom,mdss-dsi-panel-saturation-command01 = [          //CE Off
  39 01 00 00 00 00 03 E4 00 00
	];
	qcom,mdss-dsi-panel-saturation-command02 = [             //CE Low
	39 01 00 00 00 00 03 E4 01 01
	];
	qcom,mdss-dsi-panel-saturation-command03 = [              //CE Mid
  39 01 00 00 00 00 03 E4 01 02
	
	];
	qcom,mdss-dsi-panel-saturation-command04 = [              //CE High
  39 01 00 00 00 00 03 E4 01 03
	];

	};
};
