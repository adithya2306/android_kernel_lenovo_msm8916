/* Copyright (c) 2013, The Linux Foundation. All rights reserved.
 *
 * This program is free software; you can redistribute it and/or modify
 * it under the terms of the GNU General Public License version 2 and
 * only version 2 as published by the Free Software Foundation.
 *
 * This program is distributed in the hope that it will be useful,
 * but WITHOUT ANY WARRANTY; without even the implied warranty of
 * MERCHANTABILITY or FITNESS FOR A PARTICULAR PURPOSE.  See the
 * GNU General Public License for more details.
 */

/*---------------------------------------------------------------------------
 * This file is autogenerated file using gcdb parser. Please do not edit it.
 * Update input XML file to add a new entry or update variable in this file
 * VERSION = "1.0"
 *---------------------------------------------------------------------------*/
&mdss_mdp {
	dsi_ili9881c_otm_720p_video: qcom,mdss_dsi_ili9881c_720p_video {
		qcom,mdss-dsi-panel-name = "ili9881_HD720p_video_tianma";
		qcom,mdss-dsi-panel-controller = <&mdss_dsi0>;
		qcom,mdss-dsi-panel-type = "dsi_video_mode";
		qcom,mdss-dsi-panel-destination = "display_1";
		qcom,mdss-dsi-panel-framerate = <60>;
		qcom,mdss-dsi-virtual-channel-id = <0>;
		qcom,mdss-dsi-stream = <0>;
		qcom,mdss-dsi-panel-width = <720>;
		qcom,mdss-dsi-panel-height = <1280>;
		qcom,mdss-dsi-h-front-porch = <176>;
		qcom,mdss-dsi-h-back-porch = <252>;
		qcom,mdss-dsi-h-pulse-width = <28>;
		qcom,mdss-dsi-h-sync-skew = <0>;
		qcom,mdss-dsi-v-back-porch = <20>;
		qcom,mdss-dsi-v-front-porch = <28>;
		qcom,mdss-dsi-v-pulse-width = <4>;
		qcom,mdss-dsi-h-left-border = <0>;
		qcom,mdss-dsi-h-right-border = <0>;
		qcom,mdss-dsi-v-top-border = <0>;
		qcom,mdss-dsi-v-bottom-border = <0>;
		qcom,mdss-dsi-bpp = <24>;
		qcom,mdss-dsi-color-order = "rgb_swap_rgb";
		qcom,mdss-dsi-underflow-color = <0xff>;
		qcom,mdss-dsi-border-color = <0>;
		qcom,mdss-dsi-on-command = [ 
		
		39 01 00 00 00 00 04 FF 98 81 03
		39 01 00 00 00 00 02 01 00 
		39 01 00 00 00 00 02 02 00  
		39 01 00 00 00 00 02 03 73 
		39 01 00 00 00 00 02 04 D3 
		39 01 00 00 00 00 02 05 00  
		39 01 00 00 00 00 02 06 0A 
		39 01 00 00 00 00 02 07 0E 
		39 01 00 00 00 00 02 08 00 
		39 01 00 00 00 00 02 09 01 
		39 01 00 00 00 00 02 0A 01 
		39 01 00 00 00 00 02 0B 01 
		39 01 00 00 00 00 02 0C 01 
		39 01 00 00 00 00 02 0D 01 
		39 01 00 00 00 00 02 0E 01 
		39 01 00 00 00 00 02 0F 15 
		39 01 00 00 00 00 02 10 15 
		39 01 00 00 00 00 02 11 00 
		39 01 00 00 00 00 02 12 00 
		39 01 00 00 00 00 02 13 00 
		
		39 01 00 00 00 00 02 14 00 
		39 01 00 00 00 00 02 15 00 
		39 01 00 00 00 00 02 16 00 
		39 01 00 00 00 00 02 17 00 
		39 01 00 00 00 00 02 18 00 
		39 01 00 00 00 00 02 19 00 
		39 01 00 00 00 00 02 1A 00 
		39 01 00 00 00 00 02 1B 00 
		39 01 00 00 00 00 02 1C 00 
		39 01 00 00 00 00 02 1D 00 
		39 01 00 00 00 00 02 1E 40 
		39 01 00 00 00 00 02 1F 80 
		39 01 00 00 00 00 02 20 06 
		39 01 00 00 00 00 02 21 01 
		39 01 00 00 00 00 02 22 00 
		39 01 00 00 00 00 02 23 00 
		39 01 00 00 00 00 02 24 00 
		39 01 00 00 00 00 02 25 00 
		39 01 00 00 00 00 02 26 00 
		39 01 00 00 00 00 02 27 00 
		
		39 01 00 00 00 00 02 28 33				
		39 01 00 00 00 00 02 29 03
		39 01 00 00 00 00 02 2A 00
		39 01 00 00 00 00 02 2B 00
		39 01 00 00 00 00 02 2C 00
		39 01 00 00 00 00 02 2D 00
		39 01 00 00 00 00 02 2E 00
		39 01 00 00 00 00 02 2F 00
		39 01 00 00 00 00 02 30 00
		39 01 00 00 00 00 02 31 00
		39 01 00 00 00 00 02 32 00
		39 01 00 00 00 00 02 33 00
		39 01 00 00 00 00 02 34 03
		39 01 00 00 00 00 02 35 00
		39 01 00 00 00 00 02 36 03
		39 01 00 00 00 00 02 37 00
		39 01 00 00 00 00 02 38 00
		39 01 00 00 00 00 02 39 00
		39 01 00 00 00 00 02 3A 40
		39 01 00 00 00 00 02 3B 40
		
		39 01 00 00 00 00 02 3C 00		
		39 01 00 00 00 00 02 3D 00
		39 01 00 00 00 00 02 3E 00
		39 01 00 00 00 00 02 3F 00
		39 01 00 00 00 00 02 40 00
		39 01 00 00 00 00 02 41 00
		39 01 00 00 00 00 02 42 00
		39 01 00 00 00 00 02 43 00
		39 01 00 00 00 00 02 44 00
		39 01 00 00 00 00 02 50 01
		39 01 00 00 00 00 02 51 23
		39 01 00 00 00 00 02 52 45
		39 01 00 00 00 00 02 53 67
		39 01 00 00 00 00 02 54 89
		39 01 00 00 00 00 02 55 AB
		39 01 00 00 00 00 02 56 01
		39 01 00 00 00 00 02 57 23
		39 01 00 00 00 00 02 58 45
		39 01 00 00 00 00 02 59 67
		39 01 00 00 00 00 02 5A 89
		
		39 01 00 00 00 00 02 5B AB		
		39 01 00 00 00 00 02 5C CD
		39 01 00 00 00 00 02 5D EF
		39 01 00 00 00 00 02 5E 11
		39 01 00 00 00 00 02 5F 0D
		39 01 00 00 00 00 02 60 0C
		39 01 00 00 00 00 02 61 0F
		39 01 00 00 00 00 02 62 0E
		39 01 00 00 00 00 02 63 06
		39 01 00 00 00 00 02 64 07
		39 01 00 00 00 00 02 65 02
		39 01 00 00 00 00 02 66 02
		39 01 00 00 00 00 02 67 02
		39 01 00 00 00 00 02 68 02
		39 01 00 00 00 00 02 69 02
		39 01 00 00 00 00 02 6A 02
		39 01 00 00 00 00 02 6B 02
		39 01 00 00 00 00 02 6C 02
		39 01 00 00 00 00 02 6D 02
		39 01 00 00 00 00 02 6E 02

		39 01 00 00 00 00 02 6F 02	
		39 01 00 00 00 00 02 70 02
		39 01 00 00 00 00 02 71 02
		39 01 00 00 00 00 02 72 08
		39 01 00 00 00 00 02 73 00
		39 01 00 00 00 00 02 74 01
		39 01 00 00 00 00 02 75 0D
		39 01 00 00 00 00 02 76 0C
		39 01 00 00 00 00 02 77 0F
		39 01 00 00 00 00 02 78 0E
		39 01 00 00 00 00 02 79 06
		39 01 00 00 00 00 02 7A 07
		39 01 00 00 00 00 02 7B 02
		39 01 00 00 00 00 02 7C 02
		39 01 00 00 00 00 02 7D 02
		39 01 00 00 00 00 02 7E 02
		39 01 00 00 00 00 02 7F 02
		39 01 00 00 00 00 02 80 02
		39 01 00 00 00 00 02 81 02
		39 01 00 00 00 00 02 82 02
		
		39 01 00 00 00 00 02 83 02 
		39 01 00 00 00 00 02 84 02 
		39 01 00 00 00 00 02 85 02 
		39 01 00 00 00 00 02 86 02 
		39 01 00 00 00 00 02 87 02 
		39 01 00 00 00 00 02 88 08 
		39 01 00 00 00 00 02 89 00 
		39 01 00 00 00 00 02 8A 01 
		39 01 00 00 00 00 04 FF 98 81 04 
		39 01 00 00 00 00 02 6C 15 
		39 01 00 00 00 00 02 6E 3B 
		39 01 00 00 00 00 02 6F 37 
		39 01 00 00 00 00 02 8D 14 
		39 01 00 00 00 00 02 3A A4 
		39 01 00 00 00 00 02 87 BA 
		39 01 00 00 00 00 02 26 76 
		39 01 00 00 00 00 02 B2 D1 
		39 01 00 00 00 00 04 FF 98 81 01 
		39 01 00 00 00 00 02 22 0A 
		39 01 00 00 00 00 02 31 00 
		
		
		39 01 00 00 00 00	02 50 96	
		39 01 00 00 00 00 02 51 96
		39 01 00 00 00 00 02 53 6F
		39 01 00 00 00 00 02 55 6E
		39 01 00 00 00 00 02 60 14
		39 01 00 00 00 00 02 A0 05
		39 01 00 00 00 00 02 A1 36
		39 01 00 00 00 00 02 A2 3F
		39 01 00 00 00 00 02 A3 14
		39 01 00 00 00 00 02 A4 1A
		39 01 00 00 00 00 02 A5 2B
		39 01 00 00 00 00 02 A6 1E
		39 01 00 00 00 00 02 A7 20
		39 01 00 00 00 00 02 A8 AC
		39 01 00 00 00 00 02 A9 1C
		39 01 00 00 00 00 02 AA 28
		39 01 00 00 00 00 02 AB 92
		39 01 00 00 00 00 02 AC 1D
		39 01 00 00 00 00 02 AD 1D
		39 01 00 00 00 00 02 AE 53

		39 01 00 00 00 00	02 AF 25	
		39 01 00 00 00 00 02 B0 28
		39 01 00 00 00 00 02 B1 48
		39 01 00 00 00 00 02 B2 4C
		39 01 00 00 00 00 02 B3 1F
		39 01 00 00 00 00 02 C0 05
		39 01 00 00 00 00 02 C1 36
		39 01 00 00 00 00 02 C2 3F
		39 01 00 00 00 00 02 C3 14
		39 01 00 00 00 00 02 C4 1A
		39 01 00 00 00 00 02 C5 2B
		39 01 00 00 00 00 02 C6 1E
		39 01 00 00 00 00 02 C7 20
		39 01 00 00 00 00 02 C8 AC
		39 01 00 00 00 00 02 C9 1C
		39 01 00 00 00 00 02 CA 28
		39 01 00 00 00 00 02 CB 92
		39 01 00 00 00 00 02 CC 1D
		39 01 00 00 00 00 02 CD 1D
		39 01 00 00 00 00 02 CE 53
		

		39 01 00 00 00 00 02 CF 25
		39 01 00 00 00 00 02 D0 28
		39 01 00 00 00 00 02 D1 48
		39 01 00 00 00 00 02 D2 4C
		39 01 00 00 00 00 02 D3 1F
		39 01 00 00 00 00 04 FF 98 81 00
		39 01 00 00 00 00 02 51 0F
		39 01 00 00 00 00 02 53 24
		39 01 00 00 00 00 02 55 00
		39 01 00 00 00 00 02 35 00
		
		05 01 00 00 74 00 02 11 00 
		05 01 00 00 14 00 02 29 00
];

		qcom,mdss-dsi-off-command = [05 01 00 00 0a 00 02 28 00
					05 01 00 00 8c 00 02 10 00];
		qcom,mdss-dsi-on-command-state = "dsi_lp_mode";
		qcom,mdss-dsi-off-command-state = "dsi_hs_mode";
		qcom,mdss-dsi-h-sync-pulse = <1>;
		qcom,mdss-dsi-traffic-mode = "burst_mode";
		qcom,mdss-dsi-bllp-eof-power-mode;
		qcom,mdss-dsi-bllp-power-mode;
		qcom,mdss-dsi-lane-map = "lane_map_0123";
		qcom,mdss-dsi-lane-0-state;
		qcom,mdss-dsi-lane-1-state;
		qcom,mdss-dsi-lane-2-state;
		qcom,mdss-dsi-lane-3-state;
		qcom,mdss-dsi-hfp-power-mode;
		qcom,mdss-dsi-hbp-power-mode;
		qcom,mdss-dsi-hsa-power-mode;
		qcom,mdss-dsi-panel-timings = [72 1c 12 00 40 42 16 1e 14 03 04 00];
		qcom,mdss-dsi-t-clk-post = <0x04>;
		qcom,mdss-dsi-t-clk-pre = <0x1b>;
		qcom,mdss-dsi-bl-min-level = <3>;
		qcom,mdss-dsi-bl-max-level = <255>;
		qcom,mdss-dsi-bl-pmic-pwm-frequency = <100>;
		qcom,mdss-dsi-bl-pmic-bank-select = <0>;
		qcom,mdss-dsi-dma-trigger = "trigger_sw";
		qcom,mdss-dsi-mdp-trigger = "none";
		qcom,mdss-dsi-bl-pmic-control-type = "bl_ctrl_pwm";
		qcom,mdss-dsi-reset-sequence = <1 1>, <0 10>, <1 120>;
		qcom,mdss-pan-physical-width-dimension = <59>;
		qcom,mdss-pan-physical-height-dimension = <104>;
	};
};
